/*
 * Copyright (c) 2022 The ZMK Contributors
 *
 * SPDX-License-Identifier: MIT
 */

#include <dt-bindings/zmk/matrix_transform.h>
#include <physical_layouts.dtsi>

#include <layouts/foostan/corne/6column.dtsi>
// Assigning suitable kscan and matrix transforms
&foostan_corne_6col_layout {
	transform = <&default_transform>;
	kscan = <&kscan0>;
};
